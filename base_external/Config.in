## base_external/Config.in
```kconfig
source "$BR2_EXTERNAL_XGDEVICE_PATH/package/aesd-final/Config.in"
source "$BR2_EXTERNAL_XGDEVICE_PATH/package/aesd-sensor/Config.in"
source "$BR2_EXTERNAL_XGDEVICE_PATH/package/aesd-app/Config.in"
```

## base_external/configs/xg_project_mini_defconfig
```kconfig
BR2_aarch64=y
BR2_ARM_FPU_VFPV4=y
BR2_PACKAGE_HOST_LINUX_HEADERS_CUSTOM_5_15=y
BR2_TOOLCHAIN_BUILDROOT_CXX=y
BR2_TARGET_GENERIC_HOSTNAME="XIANGGUAN"
BR2_TARGET_GENERIC_ISSUE="Welcome to Xiang Guan Deng's Linux"
BR2_TARGET_GENERIC_ROOT_PASSWD="root"
BR2_INIT_SYSTEMD=y
BR2_SYSTEM_DHCP="eth0"
BR2_SYSTEM_DEFAULT_PATH="/bin:/sbin:/usr/bin:/usr/sbin"
# BR2_ROOTFS_OVERLAY="../base_external/rootfs_overlay"
BR2_PACKAGE_RPI_FIRMWARE=y
BR2_PACKAGE_RPI_FIRMWARE_BOOTCODE_BIN=y
BR2_PACKAGE_RPI_FIRMWARE_VARIANT_PI=y
BR2_PACKAGE_RPI_FIRMWARE_CONFIG_FILE="board/raspberrypi/config_default.txt"
BR2_PACKAGE_LINUX_FIRMWARE=y
BR2_ROOTFS_POST_BUILD_SCRIPT="board/raspberrypi3-64/post-build.sh"
BR2_ROOTFS_POST_IMAGE_SCRIPT="board/raspberrypi3-64/post-image.sh"
BR2_ROOTFS_POST_SCRIPT_ARGS="$(BR2_DEFCONFIG)"
BR2_LINUX_KERNEL=y
BR2_LINUX_KERNEL_CUSTOM_VERSION=y
BR2_LINUX_KERNEL_CUSTOM_VERSION_VALUE="5.15.18"
BR2_LINUX_KERNEL_DEFCONFIG="bcmrpi3"
BR2_LINUX_KERNEL_NEEDS_HOST_OPENSSL=y
BR2_LINUX_KERNEL_DTS_SUPPORT=y
BR2_LINUX_KERNEL_INTREE_DTS_NAME="bcm2708-rpi-b bcm2708-rpi-b-plus bcm2708-rpi-cm"
BR2_PACKAGE_DROPBEAR=y
BR2_TARGET_ROOTFS_EXT2=y
BR2_TARGET_ROOTFS_EXT2_4=y
BR2_TARGET_ROOTFS_EXT2_SIZE="250M"
# BR2_TARGET_ROOTFS_TAR is not set
BR2_PACKAGE_AESD_ASSIGNMENTS=y
BR2_PACKAGE_LDD=y
```

## base_external/package/aesd-final/Config.in
```kconfig
config BR2_PACKAGE_AESD_FINAL
	bool "aesd-assignments"
	help
	  AESD Final Project
```

## base_external/package/aesd-sensor/Config.in
```kconfig
config BR2_PACKAGE_AESD_SENSOR
	bool "sensor"
	help
	  AESD Final Project Sensor Driver
```

## base_external/package/ldd/Config.in
```kconfig
config BR2_PACKAGE_LDD
	bool "aesd-assignments7 building LDD3 device drivers"
	help
	  Includes the writer executable, finder.sh and tester.sh in the kernel image.
	  Used to understand buildroot external trees and package builds.
```
